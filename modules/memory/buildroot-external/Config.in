## modules/memory/buildroot-external/Config.in
```kconfig
menu "CompressOS-HAL experimental components"
source "$BR2_EXTERNAL_COMPRESSO_PATH/package/compresso-memoryd/Config.in"
source "$BR2_EXTERNAL_COMPRESSO_PATH/package/compresso-cas/Config.in"
source "$BR2_EXTERNAL_COMPRESSO_PATH/package/compresso-zvga/Config.in"
endmenu
```

## modules/memory/buildroot-external/configs/compresso_x86_64_defconfig
```kconfig
BR2_x86_64=y
BR2_TOOLCHAIN_BUILDROOT_GLIBC=y
BR2_INSTALL_LIBSTDCPP=y
BR2_INIT_SYSTEMD=y
BR2_TARGET_GENERIC_HOSTNAME="compresso-exp"
BR2_TARGET_GENERIC_ISSUE="CompressOS-HAL EXP rootfs prototype"
BR2_ROOTFS_DEVICE_CREATION_DYNAMIC_DEVTMPFS=y
BR2_PACKAGE_PYTHON3=y
BR2_PACKAGE_PYTHON3_SQLITE=y
BR2_PACKAGE_SQLITE=y
BR2_PACKAGE_COMPRESSO_MEMORYD=y
BR2_PACKAGE_COMPRESSO_CAS=y
BR2_PACKAGE_VULKAN_HEADERS=y
BR2_PACKAGE_VULKAN_LOADER=y
BR2_PACKAGE_COMPRESSO_ZVGA=y
BR2_TARGET_ROOTFS_EXT2=y
BR2_TARGET_ROOTFS_EXT2_4=y
BR2_TARGET_ROOTFS_TAR=y
```

## modules/memory/buildroot-external/package/compresso-cas/Config.in
```kconfig
config BR2_PACKAGE_COMPRESSO_CAS
	bool "compresso CAS indexer and auditor"
	depends on BR2_PACKAGE_PYTHON3
	select BR2_PACKAGE_PYTHON3_SQLITE
	help
	  Experimental user-space content-addressed store, SHA-256 auditor,
	  non-mutating ELF indexer and I/O route planner. It does not patch
	  executables or change kernel swap and VRAM state.
```

## modules/memory/buildroot-external/package/compresso-zvga/Config.in
```kconfig
config BR2_PACKAGE_COMPRESSO_ZVGA
	bool "compresso zVGA Vulkan compression worker"
	depends on BR2_INSTALL_LIBSTDCPP
	depends on BR2_PACKAGE_VULKAN_HEADERS
	depends on BR2_PACKAGE_VULKAN_LOADER
	help
	  Experimental bounded C++17/Vulkan worker and precompiled SPIR-V shader.
	  Shader validators are host build dependencies. This processes explicit
	  user-space buffers only; it is not a kernel ZRAM/Zswap codec and does
	  not map arbitrary process memory.
```
